## hw/misc/Kconfig
```kconfig
config APPLESMC
    bool
    depends on ISA_BUS

config ARMSSE_CPUID
    bool

config ARMSSE_MHU
    bool

config ARMSSE_CPU_PWRCTRL
    bool

config ISA_DEBUG
    bool
    depends on ISA_BUS

config ISA_TESTDEV
    bool
    default y if TEST_DEVICES
    depends on ISA_BUS

config PCI_TESTDEV
    bool
    default y if TEST_DEVICES
    depends on PCI

config IOMMU_TESTDEV
    bool
    default y if TEST_DEVICES
    depends on PCI

config EDU
    bool
    default y if TEST_DEVICES
    depends on PCI && MSI_NONBROKEN

config TSB12LV23
    bool
    depends on PCI

config I2C_ECHO
    bool
    default y if TEST_DEVICES
    depends on I2C

config PL310
    bool

config INTEGRATOR_DEBUG
    bool

config A9SCU
    bool

config ARM11SCU
    bool

config MAX78000_AES
    bool

config MAX78000_GCR
    bool

config MAX78000_ICC
    bool

config MAX78000_TRNG
    bool

config MOS6522
    bool

config MACIO
    bool
    select CUDA
    select ESCC
    select IDE_MACIO
    select MAC_DBDMA
    select MAC_NVRAM
    select MOS6522

config IVSHMEM_DEVICE
    bool
    default y if PCI_DEVICES
    depends on PCI && LINUX && IVSHMEM && MSI_NONBROKEN

config IVSHMEM_FLAT_DEVICE
    bool
    default y
    depends on LINUX && IVSHMEM

config ECCMEMCTL
    bool

config IMX
    bool
    select PTIMER
    select SSI
    select USB_EHCI_SYSBUS

config FSL_IMX8MP_ANALOG
    bool

config FSL_IMX8MP_CCM
    bool

config STM32_RCC
    bool

config STM32F2XX_SYSCFG
    bool

config STM32F4XX_SYSCFG
    bool

config STM32F4XX_EXTI
    bool

config STM32L4X5_EXTI
    bool

config STM32L4X5_SYSCFG
    bool
```
